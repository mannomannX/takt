## CMakeLists.txt
```
# Takt ueber CMSIS-RTOS2 (12.11, M11 Schritt 19c): das Pruefprogramm der
# Portpruefung mit dem generischen Adapter `ports/cmsis-rtos2`, unter
# Zephyrs CMSIS-Schicht auf `blackpill_f401cc`.
#
#   west build -b blackpill_f401cc examples/cmsis-rtos2 --
#       -DTAKT_EXECUTABLE=<takt> -DTAKT_SDK_LIBRARY=<SDK-Archiv des Ziels>
#
# Leitung und Rueckgabe des Boards teilt es mit `examples/zephyr`.

cmake_minimum_required(VERSION 3.20.0)

set(TAKT_ROOT ${CMAKE_CURRENT_LIST_DIR}/../..)
list(APPEND ZEPHYR_EXTRA_MODULES ${TAKT_ROOT})
find_package(Zephyr REQUIRED HINTS $ENV{ZEPHYR_BASE})
project(takt_cmsis_rtos2 C)

if(NOT BOARD STREQUAL "blackpill_f401cc")
  message(FATAL_ERROR "examples/cmsis-rtos2: geprueft auf blackpill_f401cc, nicht auf ${BOARD}")
endif()

# Im Sim-Build, wie `takt port-test --emit embed` es liefert.
takt_add_program(port_test SOURCE ${TAKT_ROOT}/corpus-try/124_port_test.takt
                 HARDWARE ${TAKT_ROOT}/corpus-try/hw/stm32f401.hw BUILD sim)

set(shared ${TAKT_ROOT}/examples/zephyr/src)
target_include_directories(app PRIVATE ${shared})
target_sources(app PRIVATE src/main.c ${shared}/line.c ${shared}/handback.c ${shared}/handback_stm32f401.c)
target_link_libraries(app PRIVATE port_test)

# Ein frisches Journal fuer die Portpruefung, die mit dem Interpreter ohne
# gespeicherte Werte vergleicht; ohne ueberlebt `persist` einen Neustart.
option(TAKT_FRESH_JOURNAL "das Journal vor dem Lauf loeschen" OFF)
if(TAKT_FRESH_JOURNAL)
  target_compile_definitions(app PRIVATE TAKT_FRESH_JOURNAL=1)
else()
  target_compile_definitions(app PRIVATE TAKT_FRESH_JOURNAL=0)
endif()
```

## prj.conf
```kconfig
# Takt ueber CMSIS-RTOS2 (12.11): das Modul mit dem generischen Adapter.
CONFIG_TAKT=y
CONFIG_TAKT_PORT_CMSIS_RTOS2=y

# Das Journal (5.9) im Flash, in der Partition `takt_journal` des
# Devicetree (boards/blackpill_f401cc.overlay).
CONFIG_TAKT_JOURNAL_FLASH=y

# Zephyrs CMSIS-RTOS2-Schicht und was sie verlangt: alle 56 Prioritaeten
# von CMSIS als verdraengbare des Zephyr-Kerns, Stacks mit Wasserstand.
CONFIG_CMSIS_RTOS_V2=y
CONFIG_POLL=y
CONFIG_THREAD_NAME=y
CONFIG_THREAD_STACK_INFO=y
CONFIG_THREAD_MONITOR=y
CONFIG_INIT_STACKS=y
CONFIG_NUM_PREEMPT_PRIORITIES=56
CONFIG_CMSIS_V2_THREAD_MAX_STACK_SIZE=8192

# Die Leitung (12.2, 12.5): das UART-Geraet `takt,line` aus dem Interrupt.
CONFIG_SERIAL=y
CONFIG_UART_INTERRUPT_DRIVEN=y
CONFIG_RING_BUFFER=y

# Die Frist ist auf einen Systemtick genau: 10 us.
CONFIG_SYS_CLOCK_TICKS_PER_SEC=100000

# `main` rechnet die fremde Last unter dem Jobfaden (`osPriorityHigh` ist
# im Zephyr-Kern 16) und schreibt am Ende die Bilanz.
CONFIG_MAIN_THREAD_PRIORITY=50
CONFIG_MAIN_STACK_SIZE=4096
```

## boards/blackpill_f401cc.conf
```kconfig
# Board 1 (plan/f401.md): Sektor 0 haelt der HID-Bootloader, Sektor 1 das
# Sprungbrett, Sektor 2 und 3 das Journal; die Anwendung beginnt in Sektor 4
# (0x0801_0000), wo das Sprungbrett sie startet, und hat 192 KiB.
CONFIG_FLASH_LOAD_OFFSET=0x10000
CONFIG_FLASH_LOAD_SIZE=0x30000

# Die FPU mit der ABI des Tripels `thumbv7em-none-eabihf`; `CONFIG_TAKT`
# waehlt dazu `CONFIG_FPU_SHARING`.
CONFIG_FPU=y
CONFIG_FP_HARDABI=y

# USART1 ist die Leitung, keine Konsole daneben.
CONFIG_CONSOLE=n
CONFIG_UART_CONSOLE=n

# Die Rueckgabe an den Host ist ein Neustart mit dem Wunsch im
# Backup-Register 4; den Sprung in den Bootloader macht das Sprungbrett
# (src/handback_stm32f401.c, FB-752).
CONFIG_REBOOT=y
```

## boards/blackpill_f401cc.overlay
```dts
/* Board 1: die Leitung auf USART1 (PA9/PA10) mit der Rate aller
 * F401-Programme, die der Host ohne Wissen um das laufende erreicht. */
/ {
	chosen {
		takt,line = &usart1;
	};
};

&usart1 {
	current-speed = <921600>;
};
```

## src/main.c
```c
/* Takt ueber CMSIS-RTOS2: das Pruefprogramm der Portpruefung (12.11, 13.8;
 * M11 Schritt 19c), unter Zephyrs CMSIS-Schicht auf dem F401.
 *
 * Wie `examples/zephyr`, nur mit dem generischen Adapter
 * `ports/cmsis-rtos2` (`CONFIG_TAKT_PORT_CMSIS_RTOS2`): Die Faeden legt
 * `osThreadNew` an, die Ereignisse sind binaere Semaphore, die Stacks misst
 * die Implementierung. Diese Anwendung stellt, was der Wirt stellt (12.11):
 * die Leitung, den Watchdog, das Geraet des Journals und beide Stacks;
 * Leitung und Rueckgabe des Boards teilt sie mit `examples/zephyr`.
 * Waehrend des Laufs rechnet `main` die fremde Last, danach schreibt es die
 * Bilanz, und `takt port-test --judge` urteilt.
 */
#include <stdint.h>

#include <zephyr/kernel.h>

#include "handback.h"
#include "line.h"
#include "port_test.h"
#include "takt_rtos.h"
#include "takt_sdk.h"
#include "takt_zephyr_nvm.h"

/* So viele Ticks faehrt der Port: `takt_conformance::port::TICKS`. */
#define TICKS 2000U

/* Der Watchdog des Wirts (12.11): Dieses Beispiel startet keinen. */
static void kick(void *ctx) {
    ARG_UNUSED(ctx);
}

/* Oeffnet das Geraet des Journals (5.9): zwei Slots im Flash, in der
 * Partition `takt_journal` des Devicetree (`ports/zephyr-nvm`, FB-732). Ein
 * Bau mit `TAKT_FRESH_JOURNAL` loescht sie vor dem Lauf: Die Portpruefung
 * vergleicht mit dem Interpreter ohne gespeicherte Werte; ohne ueberlebt
 * `persist` einen Neustart. 0 oder -errno. */
static int journal_open(struct takt_nvm *nvm) {
    static struct takt_zephyr_nvm journal;
    int rc = takt_zephyr_nvm_open(&journal, PARTITION_ID(takt_journal), PORT_TEST_NVM_BLOCKING_NS, nvm);
    if ((rc == 0) && (TAKT_FRESH_JOURNAL != 0)) {
        rc = takt_zephyr_nvm_clear(&journal);
    }
    return rc;
}

/* Luft ueber der Schranke des Programms in jedem Stack, damit eine tiefere
 * Messung im Urteil steht (12.3). */
#define STACK_SLACK 1024U

/* Faehrt den Kern `core` ueber den Port, waehrend `main` die fremde Last
 * rechnet, und schreibt die Bilanz. Verlangt der Host das Board zurueck,
 * gibt `main` es sofort ab. */
static void drive(takt_core *core) {
    /* Die Stacks beider Faeden: `osThreadNew` legt sie unter Zephyr mit
     * `k_thread_create` an, also als Stackobjekte, und `stack_size` ist ihre
     * nutzbare Groesse (`ports/cmsis-rtos2/takt_os_types.h`). */
    static K_THREAD_STACK_DEFINE(tick_stack, PORT_TEST_TICK_STACK_BYTES + STACK_SLACK);
    static K_THREAD_STACK_DEFINE(job_stack, PORT_TEST_JOB_STACK_BYTES + STACK_SLACK);
    static struct takt_rtos rtos;
    const struct takt_rtos_config config = {
        .ticks = TICKS,
        .tick_ns = PORT_TEST_TICK_NS,
        .tick_stack = tick_stack,
        .tick_stack_bytes = K_THREAD_STACK_SIZEOF(tick_stack),
        .job_stack = job_stack,
        .job_stack_bytes = K_THREAD_STACK_SIZEOF(job_stack),
        .step_priority = TAKT_OS_STEP_PRIORITY,
        .job_priority = TAKT_OS_JOB_PRIORITY,
    };
    takt_foreign foreign = {0U, 0U};
    struct takt_stacks stacks;
    const struct takt_stacks *measured = NULL;
    if (takt_rtos_start(&rtos, core, &config) == 0) {
        /* Die fremde Aufgabe: rechnet mit der FPU, solange Takt laeuft. */
        while (takt_rtos_running(&rtos) != 0) {
            takt_foreign_round(&foreign);
            handback_serve();
        }
        if (takt_rtos_join(&rtos, &stacks) == 0) {
            stacks.tick_bound = PORT_TEST_TICK_STACK_BYTES;
            stacks.job_bound = PORT_TEST_JOB_STACK_BYTES;
            measured = &stacks;
        }
    } else {
        takt_board_trace("takt port: kein Start\n");
    }
    takt_core_report(core, measured, &foreign);
}

/* Ein Schritt vor dem Lauf scheiterte: Er steht mit seinem Code auf der
 * Leitung, bevor das Board auf den Host wartet. Ohne `takt_line_flush`
 * bliebe er im Ring, denn den gibt der Kern erst nach einem Tick ab, und
 * die Leitung schwiege (FB-757). */
static void refused(const char *what, int32_t code) {
    takt_board_trace(what);
    takt_board_trace_i64(code);
    takt_board_trace("\n");
    takt_line_flush();
}

int main(void) {
    static uint8_t ring[4096];
    static uint8_t current[PORT_TEST_PERSIST_BOUND];
    static uint8_t stored[PORT_TEST_PERSIST_BOUND];
    static struct port_test_arena arena;
    static takt_core core;
    static struct takt_nvm nvm;
    static const struct takt_watchdog watchdog = {NULL, kick};
    struct takt_line line;
    if ((line_open(&line) == 0) && (takt_line_init(&line, ring, sizeof ring) == TAKT_OK)) {
        int rc;
        /* Der Kopf geht gleich an die Leitung (FB-757). */
        takt_board_trace("takt auf zephyr mit cmsis-rtos2\n" TAKT_RTOS_PROTECTION "\n");
        takt_line_mark();
        takt_line_flush();
        rc = journal_open(&nvm);
        if (rc != 0) {
            refused("takt journal: nicht offen ", rc);
        } else {
            const int32_t status =
                takt_core_init_journaled(&core, &port_test_ops, &arena, NULL, TAKT_PROFILE_SHARED, &watchdog, &nvm,
                                         current, stored, PORT_TEST_PERSIST_BOUND);
            if (status != TAKT_OK) {
                refused("takt kern: nicht bereit ", status);
            } else {
                drive(&core);
            }
        }
    }
    handback_await();
    return 0;
}
```
